## conf/distro/bbb-devel.conf
```bitbake
require conf/distro/poky.conf


DISTRO = "bbb-devel"
DISTRO_NAME = "Beaglebone devel distro"
DISTRO_VERSION = "0.1+alpha-${DATE}"
```

## conf/layer.conf
```bitbake
# We have a conf and classes directory, add to BBPATH
BBPATH .= ":${LAYERDIR}"

# We have recipes-* directories, add to BBFILES
BBFILES += "${LAYERDIR}/recipes-*/*/*.bb \
	${LAYERDIR}/recipes-*/*/*.bbappend \ 
	${LAYERDIR}/images/*.bb"

BBFILE_COLLECTIONS += "bbb_devel"
BBFILE_PATTERN_bbb_devel= "^${LAYERDIR}/"
BBFILE_PRIORITY_bbb_devel= "8"
```

## conf/machine/beaglebone.conf
```bitbake
#@TYPE: Machine
#@NAME: Beaglebone 
#@DESCRIPTION: Machine configuration for the Beaglebone 

SOC_FAMILY = "ti335x"
TARGET_ARCH = "arm"

DEFAULTTUNE ?= "cortexa8hf-neon"
#MACHINE_EXTRA_RRECOMMENDS = " kernel-modules kernel-devicetree"

require conf/machine/include/soc-family.inc
require conf/machine/include/tune-cortexa8.inc

PREFERRED_PROVIDER_virtual/kernel = "linux-stable"
#PREFERRED_PROVIDER_virtual/kernel = "ti-linux"

#KERNEL_DEVICETREE = "am335x-bone.dtb am335x-boneblack.dtb am335x-bonegreen.dtb"
KERNEL_IMAGETYPE = "zImage"
#KERNEL_EXTRA_ARGS += "LOADADDR=${UBOOT_ENTRYPOINT}"

#IMAGE_INSTALL_append = " kernel-devicetree kernel-image-zimage"

PREFERRED_PROVIDER_virtual/bootloader = "u-boot"
PREFERRED_PROVIDER_u-boot = "u-boot"

UBOOT_ENTRYPOINT = "0x80008000"
UBOOT_LOADADDRESS = "0x80008000"
UBOOT_MACHINE = "am335x_boneblack_config"
BOOTENV_SIZE = "0x20000"

EXTRA_IMAGEDEPENDS += "u-boot"

SERIAL_CONSOLE = "115200 ttyO0"

IMAGE_FSTYPES = "tar.xz ext4"

MACHINE_FEATURES = "ext2 serial usbhost vfat"
```
